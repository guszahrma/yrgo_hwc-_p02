## CMakeLists.txt
```
# Blinky for the Arduino Nano ESP32.
#
# Build (from this directory, with the Zephyr environment active):
#   west build -p always -b arduino_nano_esp32/esp32s3/procpu .

cmake_minimum_required(VERSION 3.20.0)

# Our own board definition lives in this repository (zephyr/boards/arduino/nano_esp32), not in
# Zephyr. BOARD_ROOT tells Zephyr where to look; it must point to the directory that CONTAINS
# boards/, and must be set BEFORE find_package(Zephyr), which is where the board is looked up.
list(APPEND BOARD_ROOT ${CMAKE_CURRENT_SOURCE_DIR}/../..)

find_package(Zephyr REQUIRED HINTS $ENV{ZEPHYR_BASE})
project(nano_blinky)

target_sources(app PRIVATE src/main.c)
```

## prj.conf
```kconfig
# GPIO driver support (gpio_pin_configure_dt, gpio_pin_set_dt, ...).
CONFIG_GPIO=y

# Wait 1 s before booting. The console runs over the ESP32-S3's built-in USB, which disconnects on
# every reset and has to be re-attached to WSL by usbipd. Without the delay, boot output is lost.
CONFIG_BOOT_DELAY=1000
```

## src/main.c
```c
/**
 * @file Blinky for the Arduino Nano ESP32.
 *
 * Toggles the yellow LED and cycles the RGB LED red -> green -> blue once per second.
 * All pin information comes from devicetree: the aliases led0-led3 are defined by the board
 * (zephyr/boards/arduino/nano_esp32/arduino_nano_esp32_procpu.dts), so the code contains no pin
 * numbers.
 */

#include <zephyr/drivers/gpio.h>
#include <zephyr/kernel.h>

#define SLEEP_TIME_MS 1000

/* Yellow LED: alias led0, defined by the board. */
static const struct gpio_dt_spec led = GPIO_DT_SPEC_GET(DT_ALIAS(led0), gpios);

/* RGB LED, in the order the colours are shown: red -> green -> blue. */
static const struct gpio_dt_spec rgb[] = {
    GPIO_DT_SPEC_GET(DT_ALIAS(led3), gpios), /* red   */
    GPIO_DT_SPEC_GET(DT_ALIAS(led1), gpios), /* green */
    GPIO_DT_SPEC_GET(DT_ALIAS(led2), gpios), /* blue  */
};

/* Names for printing, same order as rgb[]. */
static const char* const rgb_names[] = {"red", "green", "blue"};

int main(void)
{
    int ret;
    bool led_state = true;
    size_t colour  = 0;

    /* Yellow LED: check and configure (starts on). */
    if (!gpio_is_ready_dt(&led))
    {
        printk("Error: yellow LED not ready\n");
        return 0;
    }

    ret = gpio_pin_configure_dt(&led, GPIO_OUTPUT_ACTIVE);
    if (0 > ret)
    {
        printk("Error %d: failed to configure yellow LED\n", ret);
        return 0;
    }

    /* RGB LEDs: check and configure each one (all start off). */
    for (size_t i = 0; i < ARRAY_SIZE(rgb); i++)
    {
        if (!gpio_is_ready_dt(&rgb[i]))
        {
            printk("Error: %s LED not ready\n", rgb_names[i]);
            return 0;
        }

        ret = gpio_pin_configure_dt(&rgb[i], GPIO_OUTPUT_INACTIVE);
        if (0 > ret)
        {
            printk("Error %d: failed to configure %s LED\n", ret, rgb_names[i]);
            return 0;
        }
    }

    /* Turn on the first colour. */
    gpio_pin_set_dt(&rgb[colour], 1);

    while (1)
    {
        k_msleep(SLEEP_TIME_MS);

        /* Yellow LED: toggle. */
        ret = gpio_pin_toggle_dt(&led);
        if (0 > ret)
        {
            printk("Error %d: failed to toggle yellow LED\n", ret);
            return 0;
        }
        led_state = !led_state;

        /* RGB LED: turn off the current colour, step to the next, turn it on. */
        gpio_pin_set_dt(&rgb[colour], 0);
        colour = (colour + 1) % ARRAY_SIZE(rgb);
        gpio_pin_set_dt(&rgb[colour], 1);

        printk("Yellow: %s  RGB: %s\n", led_state ? "ON " : "OFF", rgb_names[colour]);
    }

    return 0;
}
```
